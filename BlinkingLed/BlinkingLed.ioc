# file: BlinkingLed.ioc
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Mcu.Family=STM32L4
Mcu.Name=STM32L496Z(E-G)Tx
Mcu.Package=LQFP144
NVIC.PriorityGroup=NVIC_PRIORITYGROUP_4
ProjectManager.HeapSize=0x200
ProjectManager.StackSize=0x400
ProjectManager.TargetToolchain=STM32CubeIDE
RCC.HSE_VALUE=8000000
RCC.HSI48_VALUE=48000000
RCC.HSI_VALUE=16000000
RCC.LSE_VALUE=32768
RCC.MSI_VALUE=4000000
RCC.VCOOutputFreq_Value=32000000
board=custom

// file: Core/Src/main.c
/* USER CODE BEGIN Header */
/**
 ******************************************************************************
 * @file           : main.c
 * @brief          : Main program body
 ******************************************************************************
 * @attention
 *
 * Copyright (c) 2022 STMicroelectronics.
 * All rights reserved.
 *
 * This software is licensed under terms that can be found in the LICENSE file
 * in the root directory of this software component.
 * If no LICENSE file comes with this software, it is provided AS-IS.
 *
 ******************************************************************************
 */
/* USER CODE END Header */
#include "main.h"
#include "stm32l4xx_hal_gpio.h"
#include "stm32l4xx_hal_rcc.h"
#include "stm32l496xx.h"

void SystemClock_Config(void);

int main(void) {

	/* MCU Configuration--------------------------------------------------------*/

	/* Reset of all peripherals, Initializes the Flash interface and the Systick. */
	HAL_Init();

	/* USER CODE BEGIN Init */
	__HAL_RCC_GPIOC_CLK_ENABLE();
	__HAL_RCC_GPIOD_CLK_ENABLE();
	__HAL_RCC_GPIOE_CLK_ENABLE();

	GPIO_InitTypeDef gpio_C;
	gpio_C.Mode = GPIO_MODE_OUTPUT_PP;
	gpio_C.Speed = GPIO_SPEED_FREQ_LOW;
	gpio_C.Pull = GPIO_NOPULL;
	gpio_C.Pin = GPIO_PIN_6 | GPIO_PIN_7 | GPIO_PIN_8 | GPIO_PIN_9;

	GPIO_InitTypeDef gpio_E;
	gpio_E.Mode = GPIO_MODE_OUTPUT_PP;
	gpio_E.Speed = GPIO_SPEED_FREQ_LOW;
	gpio_E.Pull = GPIO_NOPULL;
	gpio_E.Pin = GPIO_PIN_4 | GPIO_PIN_5 | GPIO_PIN_6;

	GPIO_InitTypeDef gpio_D;
	gpio_D.Mode = GPIO_MODE_OUTPUT_PP;
	gpio_D.Speed = GPIO_SPEED_FREQ_LOW;
	gpio_D.Pull = GPIO_NOPULL;
	gpio_D.Pin = GPIO_PIN_3;

	HAL_GPIO_Init(GPIOC, &gpio_C);
	HAL_GPIO_Init(GPIOD, &gpio_D);
	HAL_GPIO_Init(GPIOE, &gpio_E);
	/* USER CODE END Init */

	/* Configure the system clock */
	SystemClock_Config();

	/* Initialize all configured peripherals */

	/* Infinite loop */
	while (1) {
		HAL_GPIO_TogglePin(GPIOC, GPIO_PIN_6);
		HAL_Delay(100);
		HAL_GPIO_TogglePin(GPIOC, GPIO_PIN_6);
		HAL_Delay(100);
		HAL_GPIO_TogglePin(GPIOC, GPIO_PIN_7);
		HAL_Delay(100);
		HAL_GPIO_TogglePin(GPIOC, GPIO_PIN_7);
		HAL_Delay(100);
		HAL_GPIO_TogglePin(GPIOC, GPIO_PIN_8);
		HAL_Delay(100);
		HAL_GPIO_TogglePin(GPIOC, GPIO_PIN_8);
		HAL_Delay(100);
		HAL_GPIO_TogglePin(GPIOC, GPIO_PIN_9);
		HAL_Delay(100);
		HAL_GPIO_TogglePin(GPIOC, GPIO_PIN_9);
		HAL_Delay(100);
		HAL_GPIO_TogglePin(GPIOE, GPIO_PIN_4);
		HAL_Delay(100);
		HAL_GPIO_TogglePin(GPIOE, GPIO_PIN_4);
		HAL_Delay(100);
		HAL_GPIO_TogglePin(GPIOD, GPIO_PIN_3);
		HAL_Delay(100);
		HAL_GPIO_TogglePin(GPIOD, GPIO_PIN_3);
		HAL_Delay(100);
		HAL_GPIO_TogglePin(GPIOE, GPIO_PIN_5);
		HAL_Delay(100);
		HAL_GPIO_TogglePin(GPIOE, GPIO_PIN_5);
		HAL_Delay(100);
		HAL_GPIO_TogglePin(GPIOE, GPIO_PIN_6);
		HAL_Delay(100);
		HAL_GPIO_TogglePin(GPIOE, GPIO_PIN_6);
		HAL_Delay(100);
	}
}

void SystemClock_Config(void) {
	RCC_OscInitTypeDef RCC_OscInitStruct = { 0 };
	RCC_ClkInitTypeDef RCC_ClkInitStruct = { 0 };

	/** Configure the main internal regulator output voltage
	 */
	if (HAL_PWREx_ControlVoltageScaling(PWR_REGULATOR_VOLTAGE_SCALE1)
			!= HAL_OK) {
		Error_Handler();
	}

	/** Initializes the RCC Oscillators according to the specified parameters
	 * in the RCC_OscInitTypeDef structure.
	 */
	RCC_OscInitStruct.OscillatorType = RCC_OSCILLATORTYPE_MSI;
	RCC_OscInitStruct.MSIState = RCC_MSI_ON;
	RCC_OscInitStruct.MSICalibrationValue = 0;
	RCC_OscInitStruct.MSIClockRange = RCC_MSIRANGE_6;
	RCC_OscInitStruct.PLL.PLLState = RCC_PLL_NONE;
	if (HAL_RCC_OscConfig(&RCC_OscInitStruct) != HAL_OK) {
		Error_Handler();
	}

	/** Initializes the CPU, AHB and APB buses clocks
	 */
	RCC_ClkInitStruct.ClockType = RCC_CLOCKTYPE_HCLK | RCC_CLOCKTYPE_SYSCLK
			| RCC_CLOCKTYPE_PCLK1 | RCC_CLOCKTYPE_PCLK2;
	RCC_ClkInitStruct.SYSCLKSource = RCC_SYSCLKSOURCE_MSI;
	RCC_ClkInitStruct.AHBCLKDivider = RCC_SYSCLK_DIV1;
	RCC_ClkInitStruct.APB1CLKDivider = RCC_HCLK_DIV1;
	RCC_ClkInitStruct.APB2CLKDivider = RCC_HCLK_DIV1;

	if (HAL_RCC_ClockConfig(&RCC_ClkInitStruct, FLASH_LATENCY_0) != HAL_OK) {
		Error_Handler();
	}
}

void Error_Handler(void) {
	__disable_irq();
	while (1) {
	}
}
